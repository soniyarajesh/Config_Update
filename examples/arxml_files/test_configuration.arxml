AUTOSAR XML (schema 4-2-2)
package /Test_Communication
  TC_SWS_COM_001_001 (Communication)
    5 x ecuc textual param value:
      TestId: value=TC_SWS_COM_001_001
      TestName: value=Test for Communication Stack Initialization
      RequirementId: value=SWS_COM_001
      Priority: value=High
      Category: value=Communication
package /CommunicationConfig
  i pdu IPDU_TC_SWS_COM_001_001: length=8
package /Test_Communication
  TC_SWS_COM_002_002 (Communication)
    5 x ecuc textual param value:
      TestId: value=TC_SWS_COM_002_002
      TestName: value=Test for Message Transmission
      RequirementId: value=SWS_COM_002
      Priority: value=High
      Category: value=Communication
package /CommunicationConfig
  i pdu IPDU_TC_SWS_COM_002_002: length=8
package /Test_Diagnostic
  TC_SWS_DEM_001_003 (Diagnostic)
    5 x ecuc textual param value:
      TestId: value=TC_SWS_DEM_001_003
      TestName: value=Test for Diagnostic Event Manager Initialization
      RequirementId: value=SWS_DEM_001
      Priority: value=High
      Category: value=Diagnostic
package /DiagnosticConfig
  diagnostic trouble code DTC_TC_SWS_DEM_001_003: trouble-code=0x000001
package /Test_Diagnostic
  TC_SWS_DEM_002_004 (Diagnostic)
    5 x ecuc textual param value:
      TestId: value=TC_SWS_DEM_002_004
      TestName: value=Test for DTC Storage
      RequirementId: value=SWS_DEM_002
      Priority: value=High
      Category: value=Diagnostic
package /DiagnosticConfig
  diagnostic trouble code DTC_TC_SWS_DEM_002_004: trouble-code=0x000001
package /Test_Memory
  TC_SWS_NVM_001_005 (Memory)
    5 x ecuc textual param value:
      TestId: value=TC_SWS_NVM_001_005
      TestName: value=Test for Non-Volatile Memory Initialization
      RequirementId: value=SWS_NVM_001
      Priority: value=High
      Category: value=Memory
package /Test_Memory
  TC_SWS_NVM_002_006 (Memory)
    5 x ecuc textual param value:
      TestId: value=TC_SWS_NVM_002_006
      TestName: value=Test for Data Write Operation
      RequirementId: value=SWS_NVM_002
      Priority: value=High
      Category: value=Memory
package /Test_Operating_System
  TC_SWS_OS_001_007 (Operating System)
    5 x ecuc textual param value:
      TestId: value=TC_SWS_OS_001_007
      TestName: value=Test for Operating System Initialization
      RequirementId: value=SWS_OS_001
      Priority: value=Critical
      Category: value=Operating System
package /Test_Operating_System
  TC_SWS_OS_002_008 (Operating System)
    5 x ecuc textual param value:
      TestId: value=TC_SWS_OS_002_008
      TestName: value=Test for Task Scheduling
      RequirementId: value=SWS_OS_002
      Priority: value=Critical
      Category: value=Operating System
package /Test_Communication
  TC_SWS_CAN_001_009 (Communication)
    5 x ecuc textual param value:
      TestId: value=TC_SWS_CAN_001_009
      TestName: value=Test for CAN Driver Initialization
      RequirementId: value=SWS_CAN_001
      Priority: value=High
      Category: value=Communication
package /CommunicationConfig
  i pdu IPDU_TC_SWS_CAN_001_009: length=8
package /Test_Communication
  TC_SWS_CAN_002_010 (Communication)
    5 x ecuc textual param value:
      TestId: value=TC_SWS_CAN_002_010
      TestName: value=Test for CAN Message Reception
      RequirementId: value=SWS_CAN_002
      Priority: value=High
      Category: value=Communication
package /CommunicationConfig
  i pdu IPDU_TC_SWS_CAN_002_010: length=8
